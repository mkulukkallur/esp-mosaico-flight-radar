## main/Kconfig.projbuild
```kconfig
menu "Flight Radar"

    config FR_WIFI_SSID
        string "Fallback Wi-Fi network name (SSID)"
        default ""
        help
            Normally leave empty: the radar uses the Wi-Fi network saved in the
            Mosaico's Vibe Mode settings. Set this only to override it.

    config FR_WIFI_PASSWORD
        string "Fallback Wi-Fi password"
        default ""

    config FR_MANUAL_LAT
        string "Manual latitude (overrides approximate locations)"
        default ""
        help
            Decimal degrees, e.g. 40.7128. At every start-up the radar uses, in order:
              1. a precise fix from nearby Wi-Fi networks (beaconDB, within 2 km),
              2. these manual coordinates, if both are set,
              3. an approximate fix from the internet address (ipinfo.io).
            So manual coordinates always beat an approximate fix, and are used
            immediately while the Wi-Fi lookup runs. Leave empty for automatic only.

            On a device, the "radar_location" entry in Vibe Mode > Settings >
            Shared information takes priority over these fields, so store
            installs can be configured without rebuilding.

    config FR_MANUAL_LON
        string "Manual longitude (west is negative)"
        default ""

    config FR_WIFI_GEO_URL
        string "Wi-Fi geolocation service URL"
        default "https://api.beacondb.net/v1/geolocate"

    config FR_IP_GEO_URL
        string "IP geolocation service URL"
        default "https://ipinfo.io/json"

    config FR_REVGEO_URL
        string "Town-name lookup (reverse geocoding) URL"
        default "https://nominatim.openstreetmap.org/reverse"
        help
            OpenStreetMap Nominatim; one request per start-up. Usage policy:
            https://operations.osmfoundation.org/policies/nominatim/

    config FR_GEOCODE_URL
        string "Place-name lookup (geocoding) URL"
        default "https://nominatim.openstreetmap.org/search"
        help
            Turns a radar_location ZIP code or place name into coordinates.
            One request per start-up, only when radar_location is not coordinates.

    config FR_API_BASE
        string "ADS-B API base URL"
        default "https://opendata.adsb.fi/api/v3"
        help
            Any ADSBexchange-v2-compatible API with a /lat/X/lon/Y/dist/NM endpoint.
            adsb.fi (default) is free for personal, non-commercial use, max 1 request/second.
            Alternative: https://api.adsb.lol/v2

    config FR_REFRESH_SEC
        int "Seconds between data refreshes"
        range 5 120
        default 10

    choice FR_UNITS
        prompt "Distance units"
        default FR_UNITS_IMPERIAL

        config FR_UNITS_IMPERIAL
            bool "Miles (ranges 2/5/10/25 mi)"
        config FR_UNITS_METRIC
            bool "Kilometres (ranges 3/8/15/40 km)"
    endchoice

    config FR_OVERHEAD_M
        int "OVERHEAD! distance in metres"
        range 200 10000
        default 1609
        help
            An airborne aircraft closer than this (horizontally) triggers the
            blinking OVERHEAD! sign and the alert. 1609 m = 1 mile.

    config FR_ALERT_SOUND
        bool "Play a chime when an aircraft is overhead"
        default y

    config FR_ALERT_VOLUME
        int "Chime volume (0-100)"
        range 0 100
        default 60
        depends on FR_ALERT_SOUND

    config FR_ALERT_VIBRATE
        bool "Vibrate when an aircraft is overhead"
        default y

    config FR_TIMEZONE
        string "POSIX timezone for the clock"
        default "EST5EDT,M3.2.0,M11.1.0"

endmenu
```
